## conf/distro/kiko-distro.conf
```bitbake
include conf/distro/poky.conf

DISTRO_VERSION = "kiko-0.1"

DISTRO_FEATURES_remove = " x11 wayland"
PACKAGECONFIG_append_pn-qtbase = " accessibility "
```

## conf/layer.conf
```bitbake
# We have a conf and classes directory, add to BBPATH
BBPATH .= ":${LAYERDIR}"

# We have recipes-* directories, add to BBFILES
BBFILES += "${LAYERDIR}/recipes-*/*/*.bb \
	${LAYERDIR}/recipes-*/*/*.bbappend"

BBFILE_COLLECTIONS += "seco-a62"
BBFILE_PATTERN_seco-a62 = "^${LAYERDIR}"
BBFILE_PRIORITY_seco-a62 = "6"
```
